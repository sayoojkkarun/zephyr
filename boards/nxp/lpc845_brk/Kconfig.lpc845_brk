## boards/nxp/lpc845_brk/Kconfig.lpc845_brk
```kconfig
#
# Copyright (c) 2025 Aerlync Labs Inc.
#
# SPDX-License-Identifier: Apache-2.0
#

config BOARD_LPC845_BRK
	select SOC_LPC845
	select SOC_PART_NUMBER_LPC845M301JBD48
```

## boards/nxp/lpc845_brk/lpc845_brk_defconfig
```kconfig
#
# Copyright (c) 2025 Aerlync Labs Inc.
#
# SPDX-License-Identifier: Apache-2.0
#

CONFIG_SYS_CLOCK_HW_CYCLES_PER_SEC=30000000
CONFIG_GPIO=y
CONFIG_BUILD_OUTPUT_HEX=y
CONFIG_SERIAL=y
CONFIG_UART_MCUX_VUSART=y
CONFIG_UART_CONSOLE=y
CONFIG_CONSOLE=y
```

## drivers/serial/Kconfig.mcux_vusart
```kconfig
config UART_MCUX_VUSART
	bool "MCUX LPC vUSART driver"
	depends on DT_HAS_NXP_LPC_VUSART_ENABLED
	depends on SOC_FAMILY_LPC
	select SERIAL_HAS_DRIVER
	select SERIAL_SUPPORT_INTERRUPT
	select PINCTRL
	help
	  Enable support for the NXP LPC vUSART IP block present on LPC8xx
	  microcontrollers. The driver makes use of the MCUX SDK HAL and
	  requires valid SWM assignments provided through devicetree.
```

## dts/bindings/serial/nxp,lpc-vusart.yaml
```yaml
# Copyright (c) 2025 Aerlync Labs Inc.
# SPDX-License-Identifier: Apache-2.0

description: NXP LPC vUSART controller

compatible: "nxp,lpc-vusart"

include: [uart-controller.yaml, pinctrl-device.yaml]

properties:
  reg:
    required: true

  clocks:
    required: true

  current-speed:
    type: int
    description: Default baudrate in bits per second

  "nxp,swm-tx":
    type: array
    description: |
      Pair of SWM function selector and port pin used for the TX signal.
      The values should use the macros defined in
      ``dt-bindings/mux/lpc84x-swm.h``.

  "nxp,swm-rx":
    type: array
    description: Pair of SWM function selector and port pin used for the RX signal.

  "nxp,swm-rts":
    type: array
    description: Optional SWM assignment for the RTS signal.

  "nxp,swm-cts":
    type: array
    description: Optional SWM assignment for the CTS signal.
```

## lib/nmea/Kconfig
```kconfig
# Copyright (c) 2026 Aerlync Labs Inc.
#
# SPDX-License-Identifier: Apache-2.0

menuconfig NMEA
	bool "NMEA 0183 sentence parser library"
	help
	  Enable the NMEA 0183 parser library. Provides API for
	  decoding standard GNSS sentences into structured data types.

if NMEA

config NMEA_SENTENCE_GGA
	bool "Parse GGA sentences (fix data)"
	default y
	help
	  Enable parsing of GGA sentences containing position fix data
	  including latitude, longitude, altitude, fix quality, and HDOP.

config NMEA_SENTENCE_RMC
	bool "Parse RMC sentences (recommended minimum)"
	default y
	help
	  Enable parsing of RMC sentences containing position, speed,
	  course, and date.

config NMEA_SENTENCE_GSA
	bool "Parse GSA sentences (DOP and active satellites)"
	default y
	help
	  Enable parsing of GSA sentences containing fix type, DOP values,
	  and PRNs of satellites used in the position fix.

config NMEA_SENTENCE_GSV
	bool "Parse GSV sentences (satellites in view)"
	default y
	help
	  Enable parsing of GSV sentences containing satellite PRN,
	  elevation, azimuth, and signal-to-noise ratio.

config NMEA_SENTENCE_VTG
	bool "Parse VTG sentences (course and speed)"
	default n
	help
	  Enable parsing of VTG sentences containing course over ground
	  and speed in both knots and km/h.

config NMEA_SENTENCE_GLL
	bool "Parse GLL sentences (geographic position)"
	default n
	help
	  Enable parsing of GLL sentences containing latitude, longitude,
	  and UTC time.

endif # NMEA
```

## soc/nxp/lpc/lpc84x/Kconfig
```kconfig
# Copyright (c) 2025 Aerlync Labs Inc.
# SPDX-License-Identifier: Apache-2.0

config SOC_SERIES_LPC84X
	select ARM
	select CPU_CORTEX_M0PLUS
	select CPU_CORTEX_M_HAS_SYSTICK
	select CPU_CORTEX_M_HAS_VTOR
	select HAS_MCUX
```

## soc/nxp/lpc/lpc84x/Kconfig.defconfig
```kconfig
# Copyright (c) 2025 Aerlync Labs Inc.
# SPDX-License-Identifier: Apache-2.0

if SOC_SERIES_LPC84X

config NUM_IRQS
	default 32

endif
```

## subsys/health/Kconfig
```kconfig
# Health Monitor Subsystem Configuration

# Copyright (c) 2026 Aerlync Labs Inc.
# SPDX-License-Identifier: Apache-2.0

menuconfig HEALTH_MONITOR
	bool "Enable Health Monitor subsystem"
	depends on STATS || THREAD_ANALYZER
	help
	  Enable the system health monitoring subsystem that provides
	  continuous monitoring of CPU usage, memory usage, stack usage,
	  and thread states.

if HEALTH_MONITOR

config HEALTH_MONITOR_UPDATE_INTERVAL_MS
	int "Health monitor update interval (ms)"
	default 1000
	range 100 60000
	help
	  Interval at which health metrics are collected and updated.

config HEALTH_MONITOR_CPU
	bool "Enable CPU usage monitoring"
	default y
	depends on STATS
	help
	  Enable monitoring of CPU usage percentage.

config HEALTH_MONITOR_MEMORY
	bool "Enable memory usage monitoring"
	default y
	help
	  Enable monitoring of memory usage (heap).

config HEALTH_MONITOR_STACK
	bool "Enable stack usage monitoring"
	default y
	depends on THREAD_ANALYZER
	help
	  Enable monitoring of thread stack usage.

config HEALTH_MONITOR_THREADS
	bool "Enable thread state monitoring"
	default y
	help
	  Enable monitoring of thread count and states.

config HEALTH_MONITOR_CUSTOM_METRICS
	bool "Enable user-defined custom metrics"
	default y
	help
	  Allow applications to register custom health metrics via
	  health_register_custom_metric() API.

config HEALTH_MONITOR_MAX_CUSTOM_METRICS
	int "Maximum number of custom metrics"
	default 8
	depends on HEALTH_MONITOR_CUSTOM_METRICS
	range 1 32
	help
	  Maximum number of user-defined custom metrics that can be
	  registered simultaneously.

config HEALTH_MONITOR_HISTORY
	bool "Enable metric history tracking"
	default n
	help
	  Maintain a history of metric values for trend analysis.
	  Increases memory usage.

config HEALTH_MONITOR_HISTORY_SIZE
	int "Number of history samples per metric"
	default 10
	depends on HEALTH_MONITOR_HISTORY
	range 5 100
	help
	  Number of historical samples to maintain per metric.

config HEALTH_MONITOR_SHELL
	bool "Enable health monitor shell commands"
	default y
	depends on SHELL
	help
	  Enable shell commands for querying health status and metrics.

config HEALTH_MONITOR_DEFAULT_THRESHOLDS
	bool "Use default thresholds"
	default y
	help
	  Use sensible default thresholds for common metrics.
	  Can be overridden at runtime via API.

config HEALTH_MONITOR_CPU_WARNING_THRESHOLD
	int "CPU usage warning threshold (%)"
	default 80
	depends on HEALTH_MONITOR_CPU && HEALTH_MONITOR_DEFAULT_THRESHOLDS
	range 0 100

config HEALTH_MONITOR_CPU_CRITICAL_THRESHOLD
	int "CPU usage critical threshold (%)"
	default 95
	depends on HEALTH_MONITOR_CPU && HEALTH_MONITOR_DEFAULT_THRESHOLDS
	range 0 100

config HEALTH_MONITOR_MEMORY_WARNING_THRESHOLD
	int "Memory usage warning threshold (%)"
	default 80
	depends on HEALTH_MONITOR_MEMORY && HEALTH_MONITOR_DEFAULT_THRESHOLDS
	range 0 100

config HEALTH_MONITOR_MEMORY_CRITICAL_THRESHOLD
	int "Memory usage critical threshold (%)"
	default 95
	depends on HEALTH_MONITOR_MEMORY && HEALTH_MONITOR_DEFAULT_THRESHOLDS
	range 0 100

config HEALTH_MONITOR_STACK_WARNING_THRESHOLD
	int "Stack usage warning threshold (%)"
	default 80
	depends on HEALTH_MONITOR_STACK && HEALTH_MONITOR_DEFAULT_THRESHOLDS
	range 0 100

config HEALTH_MONITOR_STACK_CRITICAL_THRESHOLD
	int "Stack usage critical threshold (%)"
	default 95
	depends on HEALTH_MONITOR_STACK && HEALTH_MONITOR_DEFAULT_THRESHOLDS
	range 0 100

module = HEALTH_MONITOR
module-str = Health Monitor
source "subsys/logging/Kconfig.template.log_config"

endif # HEALTH_MONITOR
```

## tests/subsys/health/testcase.yaml
```yaml
tests:
  subsys.health:
    tags:
      - subsys
      - health
    harness: ztest
    platform_allow:
      - nrf52840dk/nrf52840
```
